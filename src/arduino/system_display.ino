#include <U8g2lib.h>
#include <RTClib.h>
#include "DHT.h"
#include <EEPROM.h>

/*
  SISTEMA - Display Gráfico 128x64
  - DHT11 no pino 2
  - LDR no pino A0
  - Display ST7920 128x64 (software SPI: EN=13, RW=11, RS=10)
  - Joystick VRx=A2 VRy=A3 SW=7
  - LEDs: verde=5, amarelo=4, vermelho=3
  - Buzzer = 6
  - Menu aparece somente se T, U e L estiverem OK
  - Se alguma medida errada -> mostra apenas a(s) medida(s) errada(s)
  - LED amarelo pisca 3x (ALERTA) | LED vermelho + buzzer (CRÍTICO)
  - Scroll do menu apenas 1x por sessão de "tudo OK"
*/

// -------- definições de hardware --------
#define DHTPIN 2
#define DHTTYPE DHT11
DHT dht(DHTPIN, DHTTYPE);

// Display ST7920 (software SPI)
U8G2_ST7920_128X64_1_SW_SPI u8g2(U8G2_R0, 13, 11, 10);

RTC_DS1307 rtc;

const int ledGreen = 5;
const int ledYellow = 4;
const int ledRed = 3;
const int buzzer = 6;

const int joyVert = A3;  // navegação (cima/baixo)
const int joyHorz = A2;  // edição (esq/dir)
const int joySW   = 7;   // CORRIGIDO: era 7, agora é 9

const int ldrPin  = A0;

// Offset de fuso horário para Brasília (UTC-3)
const int TIMEZONE_OFFSET = -3;

// -------- limites exatos --------
const float tempMin = 12;
const float tempMax = 30;
const int   umidMin = 60; 
const int   umidMax = 80;
const int   lumMin  = 0;
const int   lumMax  = 80;

// -------- EEPROM --------
const int EEPROM_ADDR_TEMP = 0;
const int EEPROM_ADDR_HUM  = EEPROM_ADDR_TEMP + sizeof(float);
const int EEPROM_ADDR_LUM  = EEPROM_ADDR_HUM + sizeof(float);
const int EEPROM_ADDR_FLAG = EEPROM_ADDR_LUM + sizeof(int);
const byte EEPROM_FLAG_VALUE = 0x5A;

// -------- variáveis --------
float tempC = -999.0;
float hum   = -1.0;
int   lum   = 0;

bool tudoOk = false;
int  menuIndex = 0;
unsigned long lastDebounce = 0;
const unsigned long debounceDelay = 200UL;

unsigned long lastDHTreadMillis = 0;
const unsigned long DHT_INTERVAL = 2000UL;

bool menuIntroShown = false; // controla o scroll 1x

const char HAPPY_FACE[] = ":)";
const char SAD_FACE[]   = ":(";

void drawStatusLine(int y, const char *text) {
  const int textX = 5;
  u8g2.drawUTF8(textX, y, text);
}

// -------- Bitmaps para animação de boas-vindas --------
const uint8_t img_bitmap1[1024] U8X8_PROGMEM = {
  0x00, 0x00, 0x00, 0x00, 0x00, 0x00, 0x00, 0x00, 0x00, 0x00, 0x00, 0x00,
   0x00, 0x00, 0x00, 0x00, 0x00, 0x00, 0x00, 0x00, 0x00, 0x00, 0x00, 0x00,
   0x00, 0x00, 0x00, 0x00, 0x00, 0x00, 0x00, 0x00, 0x00, 0x00, 0x00, 0x00,
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   0x00, 0x00, 0x00, 0x00
};

const uint8_t img_bitmap2[1024] U8X8_PROGMEM = {
  0x00, 0x00, 0x00, 0x00, 0x00, 0x00, 0x00, 0x00, 0x00, 0x00, 0x00, 0x00,
   0x00, 0x00, 0x00, 0x00, 0x00, 0x00, 0x00, 0x00, 0x00, 0x00, 0x00, 0x00,
   0x00, 0x00, 0x00, 0x00, 0x00, 0x00, 0x00, 0x00, 0x00, 0x00, 0x00, 0x00,
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   0x00, 0x00, 0x00, 0x00
};


// Função auxiliar para obter hora local de Brasília
DateTime getBrasiliaTime() {
  DateTime utc = rtc.now();
  return DateTime(utc.unixtime() + (TIMEZONE_OFFSET * 3600));
}

// -------- setup --------
void setup() {
  Serial.begin(115200);

  if (EEPROM.read(EEPROM_ADDR_FLAG) == EEPROM_FLAG_VALUE) {
    EEPROM.get(EEPROM_ADDR_TEMP, tempC);
    EEPROM.get(EEPROM_ADDR_HUM, hum);
    EEPROM.get(EEPROM_ADDR_LUM, lum);
    if (lum < 0) lum = 0;
    if (lum > 100) lum = 100;
  }

  u8g2.begin();
  u8g2.setContrast(255);

  // Exibe animação alternando entre as duas imagens
  for (int i = 0; i < 4; i++) {  // 4 ciclos = ~2 segundos (ajuste se quiser)
    u8g2.firstPage();
    do {
      u8g2.drawXBMP(0, 0, 128, 64, (i % 2 == 0) ? img_bitmap1 : img_bitmap2);
    } while (u8g2.nextPage());
    delay(500);
  }

  // Exibe tela de boas-vindas final
  u8g2.firstPage();
  do {
    u8g2.setFont(u8g2_font_helvB10_tr);
    u8g2.drawStr(16, 28, "BEM-VINDO(a)!");
    u8g2.setFont(u8g2_font_helvR08_tr);
    u8g2.drawStr(10, 45, "Vinheria Agnello");
  } while (u8g2.nextPage());
  delay(2000);

  // RTC
  if (!rtc.begin()) {
    u8g2.firstPage();
    do {
      u8g2.setFont(u8g2_font_6x12_tr);
      u8g2.drawStr(5, 25, "RTC nao detectado");
      u8g2.drawStr(5, 40, "Verifique cabos");
    } while (u8g2.nextPage());
    while (1) delay(1000);
  }

  if (!rtc.isrunning()) {
    Serial.println("RTC parado! Configurando data/hora UTC...");
    // Exemplo: 29 out 2025, 14:30 BRT = 17:30 UTC
    rtc.adjust(DateTime(2025, 10, 29, 17, 30, 0));
  }

  dht.begin();

  pinMode(ledGreen, OUTPUT);  digitalWrite(ledGreen, LOW);
  pinMode(ledYellow, OUTPUT); digitalWrite(ledYellow, LOW);
  pinMode(ledRed, OUTPUT);    digitalWrite(ledRed, LOW);
  pinMode(buzzer, OUTPUT);    noTone(buzzer);
  pinMode(joySW, INPUT_PULLUP);

  u8g2.firstPage();
  do {
    u8g2.setFont(u8g2_font_helvR08_tr);
    u8g2.drawStr(15, 35, "Sistema pronto...");
  } while (u8g2.nextPage());
  delay(500);

  lastDHTreadMillis = millis() - DHT_INTERVAL;
  Serial.println("Setup concluido");
}

void loop() {
  int rawLDR = analogRead(ldrPin);
  lum = map(rawLDR, 0, 1023, 0, 100);
  if (lum < 0) lum = 0; if (lum > 100) lum = 100;

  if (millis() - lastDHTreadMillis >= DHT_INTERVAL) {
    lastDHTreadMillis = millis();
    float ttemp = dht.readTemperature();
    float thum  = dht.readHumidity();

    if (isnan(ttemp)) { delay(150); ttemp = dht.readTemperature(); }
    if (isnan(ttemp))  tempC = -999.0;
    else               tempC = (ttemp > 60.0) ? ((ttemp - 32.0) * 5.0 / 9.0) : ttemp;

    if (isnan(thum)) { delay(150); thum = dht.readHumidity(); }
    hum = isnan(thum) ? -1.0 : thum;

    bool tempValid = !(tempC == -999.0);
    bool humValid = !(hum < 0.0);
    if (tempValid || humValid) {
      EEPROM.put(EEPROM_ADDR_TEMP, tempC);
      EEPROM.put(EEPROM_ADDR_HUM, hum);
      EEPROM.put(EEPROM_ADDR_LUM, lum);
      EEPROM.write(EEPROM_ADDR_FLAG, EEPROM_FLAG_VALUE);
    }

    bool tempOk = !(tempC == -999.0 || tempC < tempMin || tempC > tempMax);
    bool humOk  = !(hum < 0.0 || hum < umidMin || hum > umidMax);
    bool lumOk  = !(lum < lumMin || lum > lumMax);

    Serial.print("Temp(C): ");
    if (tempC == -999.0) Serial.print("NaN"); else Serial.print(tempC);
    Serial.print(tempOk ? " :)" : " :(");
    Serial.print("  Hum(%): ");
    if (hum < 0) Serial.print("NaN"); else Serial.print(hum);
    Serial.print(humOk ? " :)" : " :(");
    Serial.print("  Lum(%): ");
    Serial.print(lum);
    Serial.println(lumOk ? " :)" : " :(");
  }

  bool tempOk = !(tempC == -999.0 || tempC < tempMin || tempC > tempMax);
  bool humOk  = !(hum < 0.0 || hum < umidMin || hum > umidMax);
  bool lumOk  = !(lum < lumMin || lum > lumMax);

  tudoOk = tempOk && humOk && lumOk;

  if (!tudoOk) {
    menuIntroShown = false;

    bool abaixoIdeal = false, acimaIdeal = false;

    u8g2.firstPage();
    do {
      DateTime agora = getBrasiliaTime();
      char horaStr[9];
      sprintf(horaStr, "%02d:%02d", agora.hour(), agora.minute());

      u8g2.setFont(u8g2_font_6x12_tr);

      int16_t x = 128 - u8g2.getStrWidth(horaStr) - 2;
      u8g2.drawStr(x, 10, horaStr);

      u8g2.setFont(u8g2_font_6x12_tr);
      int yPos = 14;

      if (!tempOk) {
        char tempLine[24];
        if (tempC == -999.0) {
          snprintf(tempLine, sizeof(tempLine), "Temp: --.-C %s", SAD_FACE);
        } else {
          int tempInt = (int)(tempC * 10);
          int inteiro = tempInt / 10;
          int decimal = tempInt % 10;
          snprintf(tempLine, sizeof(tempLine),
                   "Temp: %d.%dC %s",
                   inteiro,
                   decimal,
                   SAD_FACE);
        }
        drawStatusLine(yPos, tempLine);

        if (tempC == -999.0 || tempC < tempMin) {
          abaixoIdeal = true;
        } else if (tempC > tempMax) {
          acimaIdeal = true;
        }

        yPos += 16;
      }

      if (!humOk) {
        char humLine[24];
        if (hum < 0) {
          snprintf(humLine, sizeof(humLine), "Umid: --%% %s", SAD_FACE);
        } else {
          snprintf(humLine, sizeof(humLine), "Umid: %d%% %s", (int)hum, SAD_FACE);
        }
        drawStatusLine(yPos, humLine);

        if (hum < 0.0 || hum < umidMin) {
          abaixoIdeal = true;
        } else if (hum > umidMax) {
          acimaIdeal = true;
        }

        yPos += 16;
      }

      if (!lumOk) {
        char lumLine[24];
        snprintf(lumLine, sizeof(lumLine), "Luz: %d%% %s", lum, SAD_FACE);
        drawStatusLine(yPos, lumLine);

        if (lum < lumMin) {
          abaixoIdeal = true;
        } else if (lum > lumMax) {
          acimaIdeal = true;
        }

        yPos += 16;
      }

    } while (u8g2.nextPage());

    if (acimaIdeal) {
      digitalWrite(ledRed, HIGH);
      digitalWrite(ledYellow, LOW);
      digitalWrite(ledGreen, LOW);
      tone(buzzer, 1000);
      delay(600);
      noTone(buzzer);
    } else if (abaixoIdeal) {
      for (int i = 0; i < 3; ++i) {
        digitalWrite(ledYellow, HIGH);
        tone(buzzer, 1500);
        delay(150);
        noTone(buzzer);
        digitalWrite(ledYellow, LOW);
        delay(150);
      }
      digitalWrite(ledYellow, HIGH);
      digitalWrite(ledGreen, LOW);
      digitalWrite(ledRed, LOW);
      noTone(buzzer);
    }

    delay(600);
    return;
  }

  digitalWrite(ledGreen, HIGH);
  digitalWrite(ledYellow, LOW);
  digitalWrite(ledRed, LOW);
  noTone(buzzer);

  if (!menuIntroShown) {
    for (int scroll = 0; scroll < 3; scroll++) {
      u8g2.firstPage();
      do {
        DateTime agora = getBrasiliaTime();
        char horaStr[9];
        sprintf(horaStr, "%02d:%02d", agora.hour(), agora.minute());

        u8g2.setFont(u8g2_font_6x12_tr);

        int16_t x = 128 - u8g2.getStrWidth(horaStr) - 2;
        u8g2.drawStr(x, 10, horaStr);

        u8g2.setFont(u8g2_font_6x12_tr);
        u8g2.drawStr(5, 15, "1: Mudar horario");
        u8g2.drawStr(5, 32, "2: Ver status atual");
        u8g2.drawStr(5, 49, "3: Ver status ideal");
      } while (u8g2.nextPage());
      delay(600);
    }
    menuIntroShown = true;
  }

  u8g2.firstPage();
  do {
    DateTime agora = getBrasiliaTime();
    char horaStr[9];
    sprintf(horaStr, "%02d:%02d", agora.hour(), agora.minute());

    u8g2.setFont(u8g2_font_6x12_tr);

    int16_t x = 128 - u8g2.getStrWidth(horaStr) - 2;
    u8g2.drawStr(x, 10, horaStr);

    u8g2.setFont(u8g2_font_6x12_tr);

    if (menuIndex == 0) {
      u8g2.drawStr(5, 15, "> Mudar horario");
      u8g2.drawStr(5, 32, "  Ver status atual");
    } else if (menuIndex == 1) {
      u8g2.drawStr(5, 15, "  Mudar horario");
      u8g2.drawStr(5, 32, "> Ver status atual");
    } else {
      u8g2.drawStr(5, 32, "  Ver status atual");
    }

    if (menuIndex == 2) {
      u8g2.drawStr(5, 49, "> Ver status ideal");
    } else {
      u8g2.drawStr(5, 49, "  Ver status ideal");
    }
  } while (u8g2.nextPage());

  int valY = analogRead(joyVert);
  if (valY < 400) { menuIndex--; if (menuIndex < 0) menuIndex = 2; delay(160); }
  else if (valY > 600) { menuIndex++; if (menuIndex > 2) menuIndex = 0; delay(160); }

  if (digitalRead(joySW) == LOW) {
    if (millis() - lastDebounce > debounceDelay) {
      lastDebounce = millis();

      if (menuIndex == 0) {
        DateTime localTime = getBrasiliaTime();
        int eHour  = localTime.hour();
        int eMin   = localTime.minute();
        int eDay   = localTime.day();
        int eMonth = localTime.month();
        int eYear  = localTime.year();

        int field = 0;
        bool editing = true;

        unsigned long lastMove = 0;
        const unsigned long moveDelay = 160UL;

        while (editing) {
          int dim;
          {
            bool leap = ((eYear % 4 == 0) && (eYear % 100 != 0)) || (eYear % 400 == 0);
            if      (eMonth == 1 || eMonth == 3 || eMonth == 5 || eMonth == 7 || eMonth == 8 || eMonth == 10 || eMonth == 12) dim = 31;
            else if (eMonth == 4 || eMonth == 6 || eMonth == 9 || eMonth == 11) dim = 30;
            else dim = leap ? 29 : 28;
          }
          if (eDay > dim) eDay = dim;

          u8g2.firstPage();
          do {
            DateTime agora = getBrasiliaTime();
            char horaStr[9];
            sprintf(horaStr, "%02d:%02d", agora.hour(), agora.minute());

            u8g2.setFont(u8g2_font_6x12_tr);

            int16_t x = 128 - u8g2.getStrWidth(horaStr) - 2;
            u8g2.drawStr(x, 10, horaStr);

            u8g2.setFont(u8g2_font_6x12_tr);
            u8g2.drawStr(10, 15, "Editar horario:");

            u8g2.setCursor(20, 35);
            if (field == 0) u8g2.print("> Hora  ");
            else if (field == 1) u8g2.print("> Min   ");
            else if (field == 2) u8g2.print("> Dia   ");
            else if (field == 3) u8g2.print("> Mes   ");
            else u8g2.print("> Ano   ");

            u8g2.setCursor(20, 50);
            if (field < 2) {
              if (eHour < 10) u8g2.print("0");
              u8g2.print(eHour);
              u8g2.print(":");
              if (eMin < 10) u8g2.print("0");
              u8g2.print(eMin);
            } else if (field < 4) {
              if (eDay < 10) u8g2.print("0");
              u8g2.print(eDay);
              u8g2.print("/");
              if (eMonth < 10) u8g2.print("0");
              u8g2.print(eMonth);
            } else {
              u8g2.print(eYear);
            }
          } while (u8g2.nextPage());

          int y = analogRead(joyVert);
          int xVal = analogRead(joyHorz);
          bool swPressed = (digitalRead(joySW) == LOW);

          if (millis() - lastMove > moveDelay) {
            if (y < 400) {
              field--; if (field < 0) field = 4; lastMove = millis();
            } else if (y > 600) {
              field++; if (field > 4) field = 0; lastMove = millis();
            } else if (xVal < 400) {
              if (field == 0) { eHour--;  if (eHour  < 0)  eHour  = 23; }
              else if (field == 1) { eMin--;   if (eMin   < 0)  eMin   = 59; }
              else if (field == 2) { eDay--;   if (eDay   < 1)  eDay   = dim; }
              else if (field == 3) { eMonth--; if (eMonth < 1)  eMonth = 12; }
              else { eYear--; if (eYear < 2020) eYear = 2099; }
              lastMove = millis();
            } else if (xVal > 600) {
              if (field == 0) { eHour++;  if (eHour  > 23) eHour  = 0; }
              else if (field == 1) { eMin++;   if (eMin   > 59) eMin   = 0; }
              else if (field == 2) { eDay++;   if (eDay   > dim) eDay   = 1; }
              else if (field == 3) { eMonth++; if (eMonth > 12) eMonth = 1; }
              else { eYear++; if (eYear > 2099) eYear = 2020; }
              lastMove = millis();
            }
          }

          if (swPressed) {
            if (millis() - lastDebounce > debounceDelay) {
              lastDebounce = millis();
              DateTime brasiliaTime(eYear, eMonth, eDay, eHour, eMin, 0);
              DateTime utcTime(brasiliaTime.unixtime() - (TIMEZONE_OFFSET * 3600));
              rtc.adjust(utcTime);

              u8g2.firstPage();
              do {
                DateTime agora = getBrasiliaTime();
                char horaStr[9];
                sprintf(horaStr, "%02d:%02d", agora.hour(), agora.minute());

                u8g2.setFont(u8g2_font_6x12_tr);

                int16_t x = 128 - u8g2.getStrWidth(horaStr) - 2;
                u8g2.drawStr(x, 10, horaStr);

                u8g2.setFont(u8g2_font_6x12_tr);
                u8g2.drawStr(10, 25, "Hora atualizada!");
                u8g2.setCursor(15, 45);
                if (eDay < 10) u8g2.print("0"); u8g2.print(eDay); u8g2.print("/");
                if (eMonth < 10) u8g2.print("0"); u8g2.print(eMonth); u8g2.print("/");
                u8g2.print(eYear); u8g2.print(" ");
                if (eHour < 10) u8g2.print("0"); u8g2.print(eHour); u8g2.print(":");
                if (eMin  < 10) u8g2.print("0"); u8g2.print(eMin);
              } while (u8g2.nextPage());

              delay(900);
              editing = false;
            }
          }

          delay(40);
        }
      }

      else if (menuIndex == 1) {
        u8g2.firstPage();
        do {
          DateTime agora = getBrasiliaTime();
          char horaStr[9];
          sprintf(horaStr, "%02d:%02d", agora.hour(), agora.minute());

          u8g2.setFont(u8g2_font_6x12_tr);

          int16_t x = 128 - u8g2.getStrWidth(horaStr) - 2;
          u8g2.drawStr(x, 10, horaStr);

          u8g2.setFont(u8g2_font_helvB08_tr);
          u8g2.drawStr(20, 15, "Status Atual");
          u8g2.setFont(u8g2_font_6x12_tr);

          char tempLine[28];
          if (tempC == -999.0) {
            snprintf(tempLine, sizeof(tempLine), "Temp: --.-C %s", SAD_FACE);
          } else {
            int tempInt = (int)(tempC * 10);
            int inteiro = tempInt / 10;
            int decimal = tempInt % 10;
            snprintf(tempLine, sizeof(tempLine),
                     "Temp: %d.%dC %s",
                     inteiro,
                     decimal,
                     tempOk ? HAPPY_FACE : SAD_FACE);
          }
          drawStatusLine(30, tempLine);

          char humLine[28];
          if (hum < 0) {
            snprintf(humLine, sizeof(humLine), "Umid: --%% %s", SAD_FACE);
          } else {
            snprintf(humLine, sizeof(humLine), "Umid: %d%% %s", (int)hum, humOk ? HAPPY_FACE : SAD_FACE);
          }
          drawStatusLine(46, humLine);

          char lumLine[28];
          snprintf(lumLine, sizeof(lumLine), "Luz:  %d%% %s", lum, lumOk ? HAPPY_FACE : SAD_FACE);
          drawStatusLine(62, lumLine);
        } while (u8g2.nextPage());
        delay(2500);
      }

      else if (menuIndex == 2) {
        u8g2.firstPage();
        do {
          DateTime agora = getBrasiliaTime();
          char horaStr[9];
          sprintf(horaStr, "%02d:%02d", agora.hour(), agora.minute());

          u8g2.setFont(u8g2_font_6x12_tr);

          int16_t x = 128 - u8g2.getStrWidth(horaStr) - 2;
          u8g2.drawStr(x, 10, horaStr);

          u8g2.setFont(u8g2_font_helvB08_tr);
          u8g2.drawStr(20, 15, "Status Ideal");
          u8g2.setFont(u8g2_font_6x12_tr);

          char tempIdeal[28];
          snprintf(tempIdeal, sizeof(tempIdeal),
              "T: %d-%dC",
              (int)tempMin,
              (int)tempMax);
          drawStatusLine(30, tempIdeal);

          char humIdeal[28];
          snprintf(humIdeal, sizeof(humIdeal), "U: %d-%d%%", umidMin, umidMax);
          drawStatusLine(46, humIdeal);

          char lumIdeal[28];
          snprintf(lumIdeal, sizeof(lumIdeal), "L: %d-%d%%", lumMin, lumMax);
          drawStatusLine(62, lumIdeal);
        } while (u8g2.nextPage());
        delay(2500);
      }
    }
  }

  delay(100);
}
